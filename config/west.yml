## config/west.yml
```yaml
manifest:
  remotes:
    - name: zmkfirmware
      url-base: https://github.com/zmkfirmware
    - name: m165437 # nice view display
      url-base: https://github.com/M165437 # nice view display
  projects:
    - name: zmk
      remote: zmkfirmware
      revision: main
      import: app/west.yml
    - name: nice-view-gem # nice view display
      remote: m165437 # nice view display
      revision: main # nice view display
  self:
    path: config
```
